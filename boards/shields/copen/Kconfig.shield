## boards/shields/copen/Kconfig.shield
```kconfig
config SHIELD_COPEN_LEFT
    def_bool $(shields_list_contains,copen_left)

config SHIELD_COPEN_RIGHT
    def_bool $(shields_list_contains,copen_right)
```

## config/boards/shields/copen2/Kconfig.defconfig
```kconfig
if SHIELD_COPEN2_R

config ZMK_KEYBOARD_NAME
    default "copen2_R"

config ZMK_SPLIT
    default y

config ZMK_SPLIT_ROLE_CENTRAL
    default y

config ZMK_POINTING
    default y

# Assuming pointing device uses SPI
config SPI
    default y

endif

if SHIELD_COPEN2_L

config ZMK_KEYBOARD_NAME
    default "copen2_L"

config ZMK_SPLIT
    default y

endif
```

## config/boards/shields/copen2/Kconfig.shield
```kconfig
config SHIELD_COPEN2_R
    def_bool $(shields_list_contains,copen2_R)

config SHIELD_COPEN2_L
    def_bool $(shields_list_contains,copen2_L)
```

## config/boards/shields/copen2_l_standalone/Kconfig.shield
```kconfig
config SHIELD_COPEN2_L_STANDALONE
    def_bool $(shields_list_contains,copen2_l_standalone)
```

## config/west.yml
```yaml
manifest:
  defaults:
    revision: v0.3
  remotes:
    - name: zmkfirmware
      url-base: https://github.com/zmkfirmware
    - name: shngsk
      url-base: https://github.com/shngsk
  projects:
    - name: zmk
      remote: zmkfirmware
      revision: main
      import: app/west.yml
    - name: zmk-pmw3610-driver
      remote: shngsk
      revision: main
  self:
    path: config
```
